## kernel/linux-4.4.x/synoconfigs/Kconfig.misc
```kconfig
menu "MISC Features"

config SYNO_HDDMON
	tristate "Syno HDD monitor"
	depends on SYNO_ATA_PWR_CTRL && SYNO_HDD_HOTPLUG

config SYNO_PLUGIN_INTERFACE
	bool "Synology plugin interface for kernel modules"
	default y

config SYNO_INCREASE_READAHEAD
	bool "Increase default max readahead"
	default y

config SYNO_MAX_READAHEAD_SIZE
	int "Set default max readahead size"
	depends on SYNO_INCREASE_READAHEAD
	default "192" if X86_64
	default "512" if !X86_64

config SYNO_BLOCK_LIMIT_BAD_SECTOR_MSG
	bool "Reduce the rate of bad sector messages"
	default y

config SYNO_IO_ERROR_LIMIT_MSG
	bool "Reduce the rate of IO error print messages"
	default y

config SYNO_IO_ERROR_LIMIT_MSG_SHIFT
	int "Reduce the rate of IO error print messages - for the variable number"
	depends on SYNO_IO_ERROR_LIMIT_MSG
	default "12"

config SYNO_EMULATE_U64_DIVISOR
	bool "Emulate caculating of u64 remainder"
	default y

config SYNO_APPARMOR_PATCH
	bool "Declare APPARMOR usage for userspace"
	default y
	depends on SECURITY_APPARMOR

config SYNO_POWEROFF_INFO_PRINT
	bool "Show pma1 and pma2 in poweroff procedure"
	default n

config SYNO_LOWER_MD_RESYNC_NICE
	bool "Lower nice value to MD resync threads"
	depends on SYNO_ALPINE
	default n

config SYNO_FIX_DM_DISK_ALIGNMENT
	bool "Fix issue of device mapper disk alignment problem"
	default y

config SYNO_OOM_DUMP_MODULE
	bool "Dump modules and occupied memory sizes while OOM"
	default y

config SYNO_ELEVATE_LOG_LEVEL
	bool "Elevate log level of kernel log"
	default y

config SYNO_DYNAMIC_IDENTIFY_CPU_NAME
	bool "dynamic identify CPU name"
	default y
	depends on SYNO_BROADWELL

config SYNO_ARM64_CPU_MODELNAME_DISPLAY
	tristate "Display cpu model for arm64"
	default y
	depends on ARM64

config SYNO_SKIP_DETACH_DVB_USB_DIB0700
	bool "skip dvb_detach for dvb-usb-dib0700 driver"
	default y

config SYNO_SKIP_UNUSED_ERROR_LOG_PCTV452E
	bool "skip unused error log from pctv452e driver"
	default y

config SYNO_DISABL_HAVE_ARCH_HUGE_VMAP
	bool "diable HAVE_ARCH_HUGE_VMAP in 4.4 kernel"
	default n

config SYNO_PSTORE
	bool "Synology enhancement of Pstore mechanism"
	default n
	depends on PSTORE

config SYNO_FIX_RTC_WAKE_AFTER_POWER_FAILURE
	bool "fix rtc wake after power failure"
	default y
	depends on SYNO_X64

config SYNO_KEY
	bool "use keys supply by our system"
	depends on KEYS

config SYNO_SYSTEM_UNTRUSTED_KEYRING
	bool "Provide system-wide ring of untrusted keys"
	depends on KEYS

config SYNO_SYSTEM_UNTRUSTED_KEYS
	string "Additional X.509 keys for default system untrusted keyring"
	depends on SYNO_SYSTEM_UNTRUSTED_KEYRING

config SYNO_REMOVE_X509_DATE_VALIDATION_CONSTRAIN
	bool "Remote x509 date validation constrain"
	depends on KEYS

endmenu #MISC Features

menu "Encryption"

endmenu #Encryption

menu "Udev"

config SYNO_DEPRECATED_UEVENT_ENV
	bool "Export deprecate uevent environment to userspace"
	default y

endmenu #Udev
```

## kernel/linux-4.4.x/synoconfigs/Kconfig.network
```kconfig
menu "Network"

config SYNO_SKIP_RXDROP_BY_CORE
	bool "Skip RX packets drop is increasing"
	default y

config SYNO_REMOVE_TCP_DEBUG
	bool "Remove tcp debug message"
	default y

config SYNO_IPV6_RFC_4862
	bool "IPv6 Stateless Address Autoconfiguration"
	default y

config SYNO_BONDING_INIT_STATUS
	bool "Initial the bonding status"
	default y

config SYNO_BONDING_FIX_ACTIVE
	bool "Fix a bug in active backup bonding mode"
	default y

config SYNO_IPV6_LINKLOCAL
	bool "Assign an interface to IPV6 link local address automatically."
	default y

config SYNO_COMPAT_WIRELESS
	bool "Select kernel config for compat-wireless"
	default y
	select WIRELESS_EXT
	select WEXT_PRIV

config SYNO_SFP_UNSUPPORTED_NOTIFY
	bool "SFP+ module unsupported notify"
	default y

config SYNO_PHY_INIT_88E151X
	bool "Enable phy driver of the phy 88E151X"
	default n

config SYNO_IPV6_EXPORT_IN6ADDR_ANY
	bool "Export in6addr_any value for modules"
	default y

config SYNO_SYSFS_EXPORT_OVS_BONDS
	bool "To export OVS bond information on sysfs"
	default y

config SYNO_NF_NAT_WORKAROUND
	bool "Fix BUG_ON on nf_nat_setup_info"
	default y

config SYNO_REMOVE_RA_ERROR_LOG
	bool "To remove error log when receiving RA"
	default y

config SYNO_ARMADA_REFILL_COUNT
	bool "Add refill fail count in statistics"
	default y
	depends on SYNO_LSP_ARMADA_17_06_01

endmenu #Network
```

## kernel/linux-4.4.x/synoconfigs/Kconfig.platform
```kconfig
menu "Platform Selection"

config SYNO_X64
	bool
	default y
	depends on X86_64

config SYNO_SELECT_PLATFORM
	def_bool y
choice
	prompt "Synology platform"

config SYNO_BROMOLOW
	bool "Intel-Bromolow"
	depends on X86_64

config SYNO_GRANTLEY
	bool "Intel Grantley"
	depends on X86_64

config SYNO_AVOTON
	bool "Intel-Avoton"
	depends on X86_64

config SYNO_BRASWELL
	bool "Intel-Braswell"
	depends on X86_64

config SYNO_APOLLOLAKE
	bool "Intel-Apollolake"
	depends on X86_64

config SYNO_KVMX64
	bool "KVM X64 Virtual machine"
	depends on X86_64

config SYNO_BROADWELL
	bool "Intel-Broadwell"
	depends on X86_64

config SYNO_DENVERTON
	bool "Intel-Denverton"
	depends on X86_64

config SYNO_DOCKERX64
	bool "Docker X64 Virtual machine"
	depends on X86_64

config SYNO_RTD129X
	bool "realtek rtd1296"
	depends on ARM64
	select SYNO_LSP_RTD129X

config SYNO_ARMADA37XX
	bool "Marvell armada37xx"
	depends on ARM64 && ARCH_MVEBU
	select SYNO_LSP_ARMADA

config SYNO_PURLEY
	bool "Intel Purley"
	depends on X86_64

config SYNO_COFFEELAKE
	bool "Intel Coffee Lake"
	depends on X86_64

endchoice

config SYNO_LSP_ARMADA
	bool "Apply Marvell armada LSP"
	depends on ARM64 && ARCH_MVEBU

config SYNO_LSP_ARMADA_16_12
	bool "Apply Marvell armada LSP devel-16.12"
	depends on SYNO_LSP_ARMADA
	default y

config SYNO_LSP_ARMADA_17_02_02
	bool "Apply Marvell armada LSP devel-17.02.02"
	depends on SYNO_LSP_ARMADA && SYNO_LSP_ARMADA_16_12
	default y

config SYNO_LSP_ARMADA_17_04_02
	bool "Apply Marvell armada LSP devel-17.04.02"
	depends on SYNO_LSP_ARMADA && SYNO_LSP_ARMADA_16_12 && SYNO_LSP_ARMADA_17_02_02
	default y

config SYNO_LSP_ARMADA_17_06_01
	bool "Apply Marvell armada LSP devel-17.06.01"
	depends on SYNO_LSP_ARMADA && SYNO_LSP_ARMADA_16_12 && SYNO_LSP_ARMADA_17_02_02 && SYNO_LSP_ARMADA_17_04_02
	default y

config SYNO_LSP_RTD129X
	bool "Apply Realtek rtd129x LSP"
	depends on ARM64 && ARCH_RTD129X

config SYNO_DUAL_HEAD
	bool "Synology Dual Head Host"
	default n
	depends on SYNO_BROMOLOW || SYNO_BROADWELL

config SYNO_SAS
	bool "Synology SAS Support"
	default y
	depends on SYNO_BROMOLOW || SYNO_BROADWELL || SYNO_GRANTLEY || SYNO_PURLEY || SYNO_COFFEELAKE

endmenu #Platform Selection
```
