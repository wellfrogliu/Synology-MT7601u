## kernel/linux-4.4.x/arch/arm64/configs/rtd129x_defconfig
```kconfig
CONFIG_CROSS_COMPILE="aarch64-linux-"
# CONFIG_LOCALVERSION_AUTO is not set
CONFIG_DEFAULT_HOSTNAME="OpenWRT-Kylin"
CONFIG_SYSVIPC=y
# CONFIG_CROSS_MEMORY_ATTACH is not set
# CONFIG_USELIB is not set
CONFIG_HIGH_RES_TIMERS=y
CONFIG_RCU_EXPERT=y
CONFIG_RCU_FANOUT=32
CONFIG_BLK_DEV_INITRD=y
CONFIG_INITRAMFS_SOURCE="root-rtd1295 initramfs-base-files.txt"
CONFIG_INITRAMFS_ROOT_UID=1000
CONFIG_INITRAMFS_ROOT_GID=1000
# CONFIG_RD_BZIP2 is not set
# CONFIG_RD_LZMA is not set
# CONFIG_RD_XZ is not set
# CONFIG_RD_LZO is not set
# CONFIG_RD_LZ4 is not set
# CONFIG_SYSFS_SYSCALL is not set
CONFIG_BPF_SYSCALL=y
# CONFIG_AIO is not set
# CONFIG_ADVISE_SYSCALLS is not set
CONFIG_EMBEDDED=y
# CONFIG_VM_EVENT_COUNTERS is not set
# CONFIG_COMPAT_BRK is not set
CONFIG_SLAB=y
CONFIG_MODULES=y
CONFIG_MODULE_UNLOAD=y
# CONFIG_BLK_DEV_BSG is not set
CONFIG_PARTITION_ADVANCED=y
CONFIG_ARCH_RTD129X=y
CONFIG_PCI=y
CONFIG_PCIE_RTD1295=y
CONFIG_PCIE2_RTD1295=y
CONFIG_SCHED_MC=y
CONFIG_SCHED_SMT=y
CONFIG_NR_CPUS=4
CONFIG_PREEMPT_VOLUNTARY=y
CONFIG_HZ_100=y
# CONFIG_COMPACTION is not set
# CONFIG_EFI is not set
# CONFIG_CORE_DUMP_DEFAULT_ELF_HEADERS is not set
CONFIG_COMPAT=y
CONFIG_WQ_POWER_EFFICIENT_DEFAULT=y
CONFIG_ARM_CPUIDLE=y
CONFIG_CPU_FREQ=y
# CONFIG_CPU_FREQ_STAT is not set
CONFIG_CPU_FREQ_GOV_POWERSAVE=y
CONFIG_CPU_FREQ_GOV_USERSPACE=y
CONFIG_CPU_FREQ_GOV_ONDEMAND=y
CONFIG_CPU_FREQ_GOV_CONSERVATIVE=y
# CONFIG_REALTEL_CPUFREQ_GPU_HELPER is not set
CONFIG_NET=y
CONFIG_PACKET=y
CONFIG_UNIX=y
CONFIG_INET=y
CONFIG_IP_MULTICAST=y
CONFIG_IP_ADVANCED_ROUTER=y
CONFIG_IP_MULTIPLE_TABLES=y
CONFIG_IP_ROUTE_MULTIPATH=y
CONFIG_IP_ROUTE_VERBOSE=y
CONFIG_IP_MROUTE=y
CONFIG_IP_MROUTE_MULTIPLE_TABLES=y
CONFIG_SYN_COOKIES=y
# CONFIG_INET_XFRM_MODE_TRANSPORT is not set
# CONFIG_INET_XFRM_MODE_TUNNEL is not set
# CONFIG_INET_XFRM_MODE_BEET is not set
# CONFIG_INET_LRO is not set
# CONFIG_INET_DIAG is not set
CONFIG_TCP_CONG_ADVANCED=y
# CONFIG_TCP_CONG_BIC is not set
# CONFIG_TCP_CONG_WESTWOOD is not set
CONFIG_TCP_CONG_HTCP=y
CONFIG_TCP_CONG_LP=y
CONFIG_DEFAULT_HTCP=y
# CONFIG_IPV6 is not set
CONFIG_NETFILTER=y
# CONFIG_BRIDGE_NETFILTER is not set
# CONFIG_NETFILTER_INGRESS is not set
CONFIG_NF_CONNTRACK=m
CONFIG_NF_CONNTRACK_FTP=m
CONFIG_NETFILTER_XT_MARK=m
CONFIG_NETFILTER_XT_TARGET_CT=m
CONFIG_NETFILTER_XT_TARGET_LOG=m
CONFIG_NETFILTER_XT_TARGET_TCPMSS=m
CONFIG_NETFILTER_XT_MATCH_COMMENT=m
CONFIG_NETFILTER_XT_MATCH_CONNTRACK=m
CONFIG_NETFILTER_XT_MATCH_LIMIT=m
CONFIG_NETFILTER_XT_MATCH_MAC=m
CONFIG_NETFILTER_XT_MATCH_MULTIPORT=m
CONFIG_NETFILTER_XT_MATCH_STATE=m
CONFIG_NETFILTER_XT_MATCH_TIME=m
CONFIG_NF_CONNTRACK_IPV4=m
# CONFIG_NF_CONNTRACK_PROC_COMPAT is not set
CONFIG_IP_NF_IPTABLES=m
CONFIG_IP_NF_FILTER=m
CONFIG_IP_NF_TARGET_REJECT=m
CONFIG_IP_NF_NAT=m
CONFIG_IP_NF_TARGET_MASQUERADE=m
CONFIG_IP_NF_TARGET_REDIRECT=m
CONFIG_IP_NF_MANGLE=m
CONFIG_IP_NF_RAW=m
CONFIG_BRIDGE=y
CONFIG_VLAN_8021Q=y
CONFIG_NET_SCHED=y
CONFIG_NET_SCH_FQ_CODEL=y
# CONFIG_WIRELESS is not set
CONFIG_UEVENT_HELPER_PATH="/sbin/hotplug"
# CONFIG_FIRMWARE_IN_KERNEL is not set
CONFIG_FW_LOADER_USER_HELPER_FALLBACK=y
CONFIG_MTD=y
CONFIG_MTD_CMDLINE_PARTS=y
CONFIG_MTD_BLOCK=y
CONFIG_BLK_DEV_RAM=y
CONFIG_BLK_DEV_SD=y
CONFIG_ATA=y
# CONFIG_ATA_VERBOSE_ERROR is not set
# CONFIG_SATA_PMP is not set
CONFIG_SATA_AHCI=y
CONFIG_AHCI_RTK=y
# CONFIG_ATA_SFF is not set
CONFIG_NETDEVICES=y
CONFIG_BONDING=y
CONFIG_NET_TEAM=y
CONFIG_NET_TEAM_MODE_BROADCAST=y
CONFIG_NET_TEAM_MODE_ROUNDROBIN=y
CONFIG_NET_TEAM_MODE_RANDOM=y
CONFIG_NET_TEAM_MODE_ACTIVEBACKUP=y
CONFIG_NET_TEAM_MODE_LOADBALANCE=y
# CONFIG_NET_VENDOR_3COM is not set
# CONFIG_NET_VENDOR_ADAPTEC is not set
# CONFIG_NET_VENDOR_AGERE is not set
# CONFIG_NET_VENDOR_ALTEON is not set
# CONFIG_NET_VENDOR_AMD is not set
# CONFIG_NET_VENDOR_ARC is not set
# CONFIG_NET_VENDOR_ATHEROS is not set
# CONFIG_NET_CADENCE is not set
# CONFIG_NET_VENDOR_BROADCOM is not set
# CONFIG_NET_VENDOR_BROCADE is not set
# CONFIG_NET_VENDOR_CAVIUM is not set
# CONFIG_NET_VENDOR_CHELSIO is not set
# CONFIG_NET_VENDOR_CISCO is not set
# CONFIG_NET_VENDOR_DEC is not set
# CONFIG_NET_VENDOR_DLINK is not set
# CONFIG_NET_VENDOR_EMULEX is not set
# CONFIG_NET_VENDOR_EZCHIP is not set
# CONFIG_NET_VENDOR_EXAR is not set
# CONFIG_NET_VENDOR_HISILICON is not set
# CONFIG_NET_VENDOR_HP is not set
# CONFIG_NET_VENDOR_INTEL is not set
# CONFIG_NET_VENDOR_MARVELL is not set
# CONFIG_NET_VENDOR_MELLANOX is not set
# CONFIG_NET_VENDOR_MICREL is not set
# CONFIG_NET_VENDOR_MYRI is not set
# CONFIG_NET_VENDOR_NATSEMI is not set
# CONFIG_NET_VENDOR_NVIDIA is not set
# CONFIG_NET_VENDOR_OKI is not set
# CONFIG_NET_PACKET_ENGINE is not set
# CONFIG_NET_VENDOR_QLOGIC is not set
# CONFIG_NET_VENDOR_QUALCOMM is not set
CONFIG_R8169SOC=y
CONFIG_R8168=y
# CONFIG_NET_VENDOR_RENESAS is not set
# CONFIG_NET_VENDOR_RDC is not set
# CONFIG_NET_VENDOR_ROCKER is not set
# CONFIG_NET_VENDOR_SAMSUNG is not set
# CONFIG_NET_VENDOR_SEEQ is not set
# CONFIG_NET_VENDOR_SILAN is not set
# CONFIG_NET_VENDOR_SIS is not set
# CONFIG_NET_VENDOR_SMSC is not set
# CONFIG_NET_VENDOR_STMICRO is not set
# CONFIG_NET_VENDOR_SUN is not set
# CONFIG_NET_VENDOR_SYNOPSYS is not set
# CONFIG_NET_VENDOR_TEHUTI is not set
# CONFIG_NET_VENDOR_TI is not set
# CONFIG_NET_VENDOR_VIA is not set
# CONFIG_NET_VENDOR_WIZNET is not set
CONFIG_PPP=m
CONFIG_PPP_FILTER=y
CONFIG_PPP_MULTILINK=y
CONFIG_PPPOE=m
CONFIG_PPP_ASYNC=m
# CONFIG_USB_NET_DRIVERS is not set
# CONFIG_WLAN is not set
# CONFIG_INPUT_MOUSEDEV is not set
# CONFIG_INPUT_KEYBOARD is not set
# CONFIG_INPUT_MOUSE is not set
CONFIG_INPUT_MISC=y
# CONFIG_SERIO is not set
# CONFIG_VT is not set
# CONFIG_LEGACY_PTYS is not set
# CONFIG_DEVMEM is not set
# CONFIG_DEVKMEM is not set
CONFIG_SERIAL_8250=y
# CONFIG_SERIAL_8250_DEPRECATED_OPTIONS is not set
CONFIG_SERIAL_8250_CONSOLE=y
# CONFIG_SERIAL_8250_PCI is not set
CONFIG_SERIAL_8250_EXTENDED=y
CONFIG_SERIAL_8250_DW=y
# CONFIG_HW_RANDOM is not set
CONFIG_I2C=y
CONFIG_I2C_CHARDEV=y
# CONFIG_I2C_HELPER_AUTO is not set
CONFIG_I2C_RTK=y
CONFIG_PINCTRL_SINGLE=y
CONFIG_PINCTRL_RTD129X=y
CONFIG_GPIOLIB=y
CONFIG_GPIO_RTD129X=y
CONFIG_THERMAL=y
CONFIG_CPU_THERMAL=y
CONFIG_WATCHDOG=y
CONFIG_RTD129X_WATCHDOG=y
CONFIG_REGULATOR=y
CONFIG_REGULATOR_G2227=y
# CONFIG_VGA_ARB is not set
# CONFIG_HID is not set
# CONFIG_USB_HID is not set
CONFIG_USB=y
CONFIG_USB_XHCI_HCD=y
CONFIG_USB_EHCI_HCD=y
CONFIG_USB_EHCI_ROOT_HUB_TT=y
CONFIG_USB_EHCI_RTK=y
CONFIG_USB_OHCI_HCD=y
CONFIG_USB_OHCI_RTK=y
# CONFIG_USB_OHCI_HCD_PCI is not set
CONFIG_USB_STORAGE=y
CONFIG_USB_DWC3=y
CONFIG_USB_RTK_DWC3_DRD_MODE=y
# CONFIG_USB_DWC3_PCI is not set
CONFIG_RTK_USB2PHY=y
CONFIG_RTK_USB3PHY=y
CONFIG_USB_GADGET=y
CONFIG_RTC_CLASS=y
CONFIG_RTC_DRV_RTD129X=y
CONFIG_COMMON_CLK_RTD129X_DEBUGFS=y
CONFIG_RTK_TIMER=y
# CONFIG_IOMMU_SUPPORT is not set
CONFIG_RTK_SB2_MEM_TRASH_MONITOR=y
CONFIG_RTK_RPC=y
CONFIG_SENDFILE_PATCH=y
CONFIG_RESET_CONTROLLER=y
CONFIG_POWER_CONTROL_DEBUGFS=y
# CONFIG_ACPI_BUTTON is not set
# CONFIG_ACPI_THERMAL is not set
CONFIG_EXT2_FS=y
CONFIG_EXT2_FS_XATTR=y
CONFIG_EXT2_FS_POSIX_ACL=y
CONFIG_EXT2_FS_SECURITY=y
CONFIG_EXT3_FS=y
CONFIG_EXT3_FS_POSIX_ACL=y
CONFIG_EXT3_FS_SECURITY=y
CONFIG_BTRFS_FS=y
CONFIG_BTRFS_FS_POSIX_ACL=y
# CONFIG_DNOTIFY is not set
CONFIG_OVERLAY_FS=y
CONFIG_FSCACHE=y
CONFIG_MSDOS_FS=y
CONFIG_VFAT_FS=y
# CONFIG_PROC_PAGE_MONITOR is not set
CONFIG_TMPFS=y
CONFIG_TMPFS_XATTR=y
# CONFIG_MISC_FILESYSTEMS is not set
CONFIG_NLS_DEFAULT="utf8"
CONFIG_NLS_CODEPAGE_437=y
CONFIG_NLS_ISO8859_1=y
CONFIG_NLS_UTF8=y
CONFIG_PRINTK_TIME=y
CONFIG_DEBUG_INFO=y
CONFIG_DEBUG_INFO_REDUCED=y
# CONFIG_ENABLE_MUST_CHECK is not set
CONFIG_FRAME_WARN=1024
CONFIG_STRIP_ASM_SYMS=y
CONFIG_DEBUG_FS=y
CONFIG_MAGIC_SYSRQ=y
# CONFIG_SCHED_DEBUG is not set
# CONFIG_DEBUG_BUGVERBOSE is not set
CONFIG_RCU_CPU_STALL_TIMEOUT=60
# CONFIG_FTRACE is not set
# CONFIG_CRYPTO_ECHAINIV is not set
CONFIG_CRYPTO_ARC4=y
# CONFIG_CRYPTO_HW is not set
CONFIG_CRC32_SARWATE=y
CONFIG_XZ_DEC=y
# CONFIG_XZ_DEC_X86 is not set
# CONFIG_XZ_DEC_POWERPC is not set
# CONFIG_XZ_DEC_IA64 is not set
# CONFIG_XZ_DEC_ARM is not set
# CONFIG_XZ_DEC_ARMTHUMB is not set
# CONFIG_XZ_DEC_SPARC is not set
```

## kernel/linux-4.4.x/drivers/clk/mvebu/Kconfig
```kconfig
config MVEBU_CLK_COMMON
	bool

config MVEBU_CLK_CPU
	bool

config MVEBU_CLK_COREDIV
	bool

config ARMADA_370_CLK
	bool
	select MVEBU_CLK_COMMON
	select MVEBU_CLK_CPU
	select MVEBU_CLK_COREDIV

config ARMADA_375_CLK
	bool
	select MVEBU_CLK_COMMON

config ARMADA_38X_CLK
	bool
	select MVEBU_CLK_COMMON

config ARMADA_39X_CLK
	bool
	select MVEBU_CLK_COMMON

config ARMADA_XP_CLK
	bool
	select MVEBU_CLK_COMMON
	select MVEBU_CLK_CPU
	select MVEBU_CLK_COREDIV

config MSYS_CLK
	bool
	depends on SYNO_LSP_ARMADA_16_12
	select MVEBU_CLK_COMMON
	select MVEBU_CLK_CPU
	select MVEBU_CLK_COREDIV

config ARMADA_3700_CLK
	bool
	depends on SYNO_LSP_ARMADA_16_12
	select MVEBU_CLK_COMMON

config ARMADA_CP110_SYSCON
	bool
	depends on SYNO_LSP_ARMADA_16_12

config DOVE_CLK
	bool
	select MVEBU_CLK_COMMON

config KIRKWOOD_CLK
	bool
	select MVEBU_CLK_COMMON

config ORION_CLK
	bool
	select MVEBU_CLK_COMMON

config ARMADA_AP806_SYSCON
	bool
	depends on SYNO_LSP_ARMADA_16_12

config ARMADA_AP806_CORE_CLK
	bool
	depends on SYNO_LSP_ARMADA_16_12

config ARMADA_AP806_RING_CLK
	bool
	depends on SYNO_LSP_ARMADA_16_12

config ARMADA_AP806_CPU_CLK
	bool
	depends on SYNO_LSP_ARMADA_16_12

config ARMADA_37XX_PM_CLK
	bool
	select REGULATOR_ARMADA3700
	depends on SYNO_LSP_ARMADA_17_04_02
```

## kernel/linux-4.4.x/drivers/clk/realtek/Kconfig
```kconfig
menuconfig COMMON_CLK_RTK
    bool "Clock driver for realtek"
    depends on ARCH_RTD129X
    default y

config COMMON_CLK_RTD129X
    bool "Clock driver for RTD129X"
    depends on COMMON_CLK_RTK
    default y

config COMMON_CLK_RTD129X_DEBUGFS
    bool "DebugFs for RTD129X clock driver"
    depends on DEBUG_FS && COMMON_CLK_RTD129X
```

## kernel/linux-4.4.x/drivers/pinctrl/realtek/Kconfig
```kconfig
config PINCTRL_RTD129X
	bool "RTD129X pin controller driver"
	select PINMUX
	select GENERIC_PINCONF
```

## kernel/linux-4.4.x/drivers/powerctrl/Kconfig
```kconfig
menu "Power Control"

config POWER_CONTROL
    bool "Power Control Support"
    default n


config POWER_CONTROL_DEBUGFS
    bool "DebugFs fpr Power Control"
    depends on POWER_CONTROL
    default n


config POWER_CONTROL_RTD129X
    bool "Power Control for RTD192x"
    depends on POWER_CONTROL
    default n


config POWER_CONTROL_RTD129X_DEBUGFS
    bool "DebugFs for RTD192x Power Control"
    depends on POWER_CONTROL_RTD129X
    default n

endmenu
```

## kernel/linux-4.4.x/drivers/soc/Kconfig
```kconfig
menu "SOC (System On Chip) specific Drivers"

source "drivers/soc/brcmstb/Kconfig"
source "drivers/soc/mediatek/Kconfig"
source "drivers/soc/qcom/Kconfig"
source "drivers/soc/rockchip/Kconfig"
source "drivers/soc/sunxi/Kconfig"
source "drivers/soc/ti/Kconfig"
source "drivers/soc/versatile/Kconfig"
if SYNO_LSP_RTD129X
source "drivers/soc/realtek/Kconfig"
endif # SYNO_LSP_RTD129X

endmenu
```

## kernel/linux-4.4.x/drivers/soc/realtek/Kconfig
```kconfig
config RTD129X
	bool "Realtek SoC drivers support"
	depends on ARCH_RTD129X
	default y
	help
	  Realtek RTD1296 SOC drivers support.

	  If unsure, say N.

if RTD129X
source "drivers/soc/realtek/rtd129x/Kconfig"
endif # RTD129X
```

## kernel/linux-4.4.x/drivers/soc/realtek/rtd129x/Kconfig
```kconfig
comment "RTD129X Device Drivers"

menu "RTD129X Device Drivers"

config RTK_SB2_MEM_TRASH_MONITOR
	bool "Memory trash monitor"
	default n
	help
	  Enable helper functions for memory trash detection. If unsure, say N.

config RTK_RBUS_BARRIER
	bool "R-bus barrier"
	depends on RTK_MEM_REMAP
	default y
	help
	  Enable helper functions for R-bus barrier. If unsure, say N.

config RTK_MEM_REMAP
	bool "Memory remap"
	default y
	help
	  Enable helper functions for static ioremap. If unsure, say N.

source "drivers/soc/realtek/rtd129x/rtk_ve/Kconfig"
source "drivers/soc/realtek/rtd129x/irda/Kconfig"
source "drivers/soc/realtek/rtd129x/rpc/Kconfig"
endmenu #RTD129X Device Drivers

menu "Realtek NAS support"
       depends on ARCH_RTD129X
 
config SENDFILE_PATCH
       bool "Reverse sendfile patch"
       default n
       help
       Use patched sendfile syscall to improve write performance on NAS.

endmenu
```

## kernel/linux-4.4.x/drivers/soc/realtek/rtd129x/rpc/Kconfig
```kconfig
config RTK_RPC
    bool "RPC driver"
    depends on RTK_MEM_REMAP
    default n
    help
      Realtek RPC driver with audio CPU
```

## kernel/linux-4.4.x/drivers/telephony/Kconfig
```kconfig
#
# Telephony device configuration
#

menuconfig PHONE
	bool "Telephony devices support"
	depends on SYNO_LSP_ARMADA_16_12
	default y
	---help---
	  Say Y here to get to see options for hardware telephony devices.
	  This option alone does not add any kernel code.

	  If you say N, all options in this submenu will be skipped and disabled.

if PHONE && SYNO_LSP_ARMADA_16_12

config MV_INCLUDE_TDM
	bool "Mvebu TDM Telephony"
	depends on ARCH_MVEBU && SYNO_LSP_ARMADA_16_12 && !SYNO_LSP_ARMADA_17_02_02
	default y
	---help---
	  This driver supports the TDM-based telephony interface
	  units in the following Marvell SoC families:
	  1. ARMADA-370.
	  2. ARMADA-375.
	  3. ARMADA-38x.
	  4. ARMADA-XP.

config MVEBU_PHONE
	bool "Mvebu TDM Telephony"
	depends on ARCH_MVEBU && SYNO_LSP_ARMADA_17_02_02
	default y
	---help---
	  This driver supports the TDM-based telephony interface
	  units in the following Marvell SoC families:
	  1. ARMADA-370.
	  2. ARMADA-375.
	  3. ARMADA-38x.
	  4. ARMADA-XP.
	  5. ARMADA-7k/8k.

if (MV_INCLUDE_TDM && SYNO_LSP_ARMADA_16_12) || (MVEBU_PHONE && SYNO_LSP_ARMADA_17_02_02)
	source "drivers/telephony/mvebu_phone/Kconfig"
endif

endif # PHONE
```

## kernel/linux-4.4.x/drivers/telephony/mvebu_phone/Kconfig
```kconfig
menu "Marvell Telephony options"
       depends on (MV_INCLUDE_TDM && SYNO_LSP_ARMADA_16_12) || (MVEBU_PHONE && SYNO_LSP_ARMADA_17_02_02)

config MV_TDMMC_SUPPORT
	bool "Support communit - multichannel TDM"
	depends on SYNO_LSP_ARMADA_16_12 && (MACH_ARMADA_XP || ARCH_MVEBU) && !SYNO_LSP_ARMADA_17_02_02
	default y
	---help---
	Choosing this option enables Marvell
	32CH TDM voice interface.
	The TDM bus may be used for transferring
	voice samples through analog phone interface.

config MV_TDM2C_SUPPORT
	bool "Support legacy TDM(2 channels)"
	depends on MACH_ARMADA_38X && SYNO_LSP_ARMADA_16_12 && !SYNO_LSP_ARMADA_17_02_02
	default y
	---help---
	Choosing this option enables Marvell
	2CH TDM voice interface.
	The TDM bus may be used for transferring
	voice samples through analog phone interface.

config MV_TDM_EXT_STATS
	bool "Enable legacy TDM extended statistics"
	depends on MACH_ARMADA_38X && SYNO_LSP_ARMADA_16_12
	default y
	---help---
	Choosing this option will export
	extended statistics to procfs.
	This is relevant only for the
	legacy TDM unit.

endmenu
```

## kernel/linux-4.4.x/drivers/thermal/realtek/Kconfig
```kconfig
config RTK_THERMAL
    tristate "Realtek thermal management"
    depends on OF
    default y

config RTK_THERMAL_CPU_CORE_COOLING
    tristate "Realtek cpu_core cooling"
    depends on RTK_THERMAL && HOTPLUG_CPU
    default y
```

## kernel/linux-4.4.x/synoconfigs/Kconfig
```kconfig
menuconfig SYNO_FEATURES
	bool "Synology Enhancement Features"

if SYNO_FEATURES

source "synoconfigs/Kconfig.platform"
source "synoconfigs/Kconfig.basic"
source "synoconfigs/Kconfig.network"
source "synoconfigs/Kconfig.devices"
source "synoconfigs/Kconfig.fs"
source "synoconfigs/Kconfig.misc"

endif #SYNO_FEATURES
```
