/*
*  DVFS table: SCPU frequency more than 1Ghz and use pmic-g2227 to control voltage
*/

/ {
    dvfs: dvfs {
        frequency-table = <
            0   1   300000
            0   1   400000
            0   1   500000
            0   1   600000
            0   1   700000
            0   3   800000
            0   4   900000
            0   5  1000000
            0   6  1100000
            2   7  1200000
            2   9  1300000
            2  11  1400000
        >;

        frequency-table,rev1 = <
            0   0   300000
            0   0   400000
            0   0   500000
            0   2   600000
            0   3   700000
            0   4   800000
            0   5   900000
            0   6  1000000
            0   8  1100000
            2  10  1200000
            2  12  1300000
            2  13  1400000
        >;

    	voltage-table = <
            0   800000	 800000
            1   812500   812500
            2   825000   825000
            3   850000   850000
            4   875000   875000
            5   900000   900000
            6   925000   925000
            7   950000   950000
            8   962500   962500
            9   975000   975000
           10  1012500  1012500
           11  1025000  1025000
           12  1062500  1062500
           13  1100000  1100000
        >;

        l2-voltage-table = <
            0   900000   900000
            1   900000   900000
            2   900000   900000
            3   900000   900000
            4   900000   900000
            5   900000   900000
            6   900000   900000
            7   900000   900000
            8   900000   900000
            9   900000   900000
           10   950000   950000
           11   950000   950000
           12  1000000  1000000
           13  1000000  1000000
        >;
    };
    
    dvfs-gpio {
        compatible         = "Realtek,rtk129x-gpio-dvfs";
        transition_latency = <500000>;

        frequency-table = <
            0   0   300000
            0   0   400000
            0   0   500000
            0   0   600000
            0   0   700000
            0   0   800000
            0   1   900000
            0   1  1000000
            0   1  1100000
            0   1  1200000
            0   2  1300000
            0   2  1400000
            0   2  1503000
        >; 

        voltage-table = <
            0    850000  850000
            1    950000  950000
            2   1050000 1050000
        >;        
    };
};
